## config/boards/shields/nice_nano_dongle/Kconfig.defconfig
```kconfig
if SHIELD_NICE_NANO_DONGLE

config ZMK_USB
  default y

config ZMK_BLE
  default y

config ZMK_KEYBOARD_NAME
  default "Nice!Nano Dongle"

endif
```

## config/boards/shields/nice_nano_dongle/Kconfig.shield
```kconfig
config SHIELD_NICE_NANO_DONGLE
  def_bool $(shields_list_contains,nice_nano_dongle)
```

## config/boards/shields/r57/Kconfig.defconfig
```kconfig
# Copyright (c) 2020 The ZMK Contributors
# SPDX-License-Identifier: MIT

if SHIELD_R57_DONGLE

config ZMK_KEYBOARD_NAME
	default "R57LP"

config ZMK_SPLIT_ROLE_CENTRAL
	default y

endif

if SHIELD_R57_DONGLE || SHIELD_R57_KB

config ZMK_SPLIT
	default y

endif
```

## config/boards/shields/r57/Kconfig.shield
```kconfig
# Copyright (c) 2020 The ZMK Contributors
# SPDX-License-Identifier: MIT

config SHIELD_R57_KEYBOARD
    def_bool $(shields_list_contains,r57_kb)

config SHIELD_R57_DONGLE
    def_bool $(shields_list_contains,r57_dongle)
```

## config/boards/shields/rev57lp/Kconfig.shield
```kconfig
# Copyright (c) 2020 The ZMK Contributors
# SPDX-License-Identifier: MIT

config SHIELD_REV57LP_KEYBOARD
    def_bool $(shields_list_contains,rev57lp_keyboard)

config SHIELD_REV57LP_DONGLE
    def_bool $(shields_list_contains,rev57lp_dongle)
```
