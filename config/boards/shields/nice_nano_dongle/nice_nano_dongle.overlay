/ {
  chosen {
    zmk,kscan = &kscan0;
  };

  kscan0: kscan {
    compatible = "zmk,kscan-gpio-direct";
    label = "default_kscan";
    input-gpios = <&gpio0 9 (GPIO_ACTIVE_LOW | GPIO_PULL_UP)>;
  };
};
